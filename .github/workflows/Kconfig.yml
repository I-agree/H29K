## files/package/boot/uboot-rockchip/configs/hinlink-h29k-rk3528_defconfig
```kconfig
# Hinlink H29K (RK3528) U-Boot defconfig
# OpenWrt 25.12+ Linux6.12

CONFIG_ARM=y
CONFIG_ARM64=y
CONFIG_SKIP_LOWLEVEL_INIT=y
CONFIG_COUNTER_FREQUENCY=24000000
CONFIG_ARCH_ROCKCHIP=y
CONFIG_SYS_SOC="rockchip"
CONFIG_ROCKCHIP_RK3528=y
# CONFIG_OF_UPSTREAM is not set
CONFIG_DEFAULT_DEVICE_TREE="rockchip/rk3528-hinlink-h29k"
CONFIG_DEFAULT_FDT_FILE="rockchip/rk3528-hinlink-h29k.dtb"

CONFIG_SYS_LOAD_ADDR=0x08080000
CONFIG_TEXT_BASE=0x00040000

# Serial (Rockchip UART, NO NS16550)
CONFIG_DEBUG_UART=y
CONFIG_DEBUG_UART_BASE=0xFF9F0000
CONFIG_DEBUG_UART_CLOCK=24000000
CONFIG_DEBUG_UART_ANNOUNCE=y
CONFIG_DEBUG_UART_SKIP_INIT=y
CONFIG_DEBUG_UART_SHIFT=2
CONFIG_ROCKCHIP_SERIAL=y
CONFIG_DEBUG_UART_ROCKCHIP=y
CONFIG_BAUDRATE=1500000

# SPL / FIT / ATF
CONFIG_FIT=y
CONFIG_SPL=y
CONFIG_SPL_FRAMEWORK=y
CONFIG_SPL_LIBCOMMON_SUPPORT=y
CONFIG_SPL_LIBGENERIC_SUPPORT=y
CONFIG_SPL_SERIAL_SUPPORT=y
CONFIG_SPL_GPIO_SUPPORT=y
CONFIG_SPL_MMC_SUPPORT=y
CONFIG_SPL_SEPARATE_BSS=y
CONFIG_SPL_LOAD_FIT=y
CONFIG_SPL_ATF=y
CONFIG_BINMAN=y
CONFIG_SPL_STACK_R=y
CONFIG_SPL_STACK_R_ADDR=0x00400000

# Device tree
CONFIG_OF_CONTROL=y
CONFIG_SPL_OF_CONTROL=y
CONFIG_OF_SPL_REMOVE_PROPS="clock-names interrupt-parent assigned-clocks assigned-clock-rates assigned-clock-parents"

# Driver model
CONFIG_DM=y
CONFIG_SPL_DM=y
CONFIG_DM_GPIO=y
CONFIG_DM_MMC=y
CONFIG_DM_ETH=y
CONFIG_DM_MDIO=y

# Memory
CONFIG_SYS_MALLOC_LEN=0x1000000
CONFIG_SYS_MALLOC_F_LEN=0x4000
CONFIG_NR_DRAM_BANKS=2
CONFIG_HAS_CUSTOM_SYS_INIT_SP_ADDR=y
CONFIG_CUSTOM_SYS_INIT_SP_ADDR=0x00c00000
CONFIG_SPL_STACK=0x00400000
CONFIG_SPL_BSS_START_ADDR=0x00408000
CONFIG_SPL_BSS_MAX_SIZE=0x4000
CONFIG_SPL_MAX_SIZE=0x40000

# MMC / eMMC
CONFIG_MMC=y
CONFIG_MMC_DW=y
CONFIG_MMC_DW_ROCKCHIP=y
CONFIG_MMC_SDHCI=y
CONFIG_MMC_SDHCI_SDMA=y
CONFIG_MMC_SDHCI_ROCKCHIP=y
CONFIG_SUPPORT_EMMC_RPMB=y

# Ethernet
CONFIG_PHY_REALTEK=y
CONFIG_DWC_ETH_QOS=y
CONFIG_DWC_ETH_QOS_ROCKCHIP=y

# USB
CONFIG_USB=y
CONFIG_USB_XHCI_HCD=y
CONFIG_USB_EHCI_HCD=y
CONFIG_USB_EHCI_GENERIC=y
CONFIG_USB_DWC3=y
CONFIG_USB_DWC3_GENERIC=y
CONFIG_USB_GADGET=y
CONFIG_USB_GADGET_DOWNLOAD=y
# CONFIG_USB_FUNCTION_FASTBOOT is not set
# CONFIG_UDP_FUNCTION_FASTBOOT is not set
# CONFIG_TCP_FUNCTION_FASTBOOT is not set
CONFIG_USB_FUNCTION_ROCKUSB=y
CONFIG_PHY_ROCKCHIP_INNO_USB2=y
CONFIG_PHY_ROCKCHIP_NANENG_COMBOPHY=y
CONFIG_FASTBOOT_BUF_ADDR=0x08080000

# PWM / Regulator / LED / Button
CONFIG_PWM_ROCKCHIP=y
CONFIG_REGULATOR_PWM=y
CONFIG_DM_REGULATOR_GPIO=y
CONFIG_LED=y
CONFIG_LED_GPIO=y
CONFIG_BUTTON=y
CONFIG_BUTTON_ADC=y
CONFIG_ROCKCHIP_GPIO=y

# Commands
CONFIG_CMD_MEMINFO=y
CONFIG_CMD_MEMINFO_MAP=y
CONFIG_CMD_ADC=y
CONFIG_CMD_GPIO=y
CONFIG_CMD_GPT=y
CONFIG_CMD_MISC=y
CONFIG_CMD_MMC=y
CONFIG_CMD_USB=y
CONFIG_CMD_ROCKUSB=y
CONFIG_CMD_USB_MASS_STORAGE=y
CONFIG_CMD_RNG=y
CONFIG_CMD_REGULATOR=y
CONFIG_CMD_BOOTI=y
CONFIG_CMD_PART=y
CONFIG_CMD_FS_GENERIC=y
CONFIG_CMD_FAT=y
CONFIG_CMD_EXT4=y

# Environment (MMC + redundant)
CONFIG_ENV_IS_IN_MMC=y
CONFIG_SYS_MMC_ENV_DEV=0
CONFIG_ENV_OFFSET=0x3f8000
CONFIG_ENV_SIZE=0x8000
CONFIG_SYS_REDUNDANT_ENVIRONMENT=y
CONFIG_ENV_OFFSET_REDUND=0x3f0000
CONFIG_BOOTSTD=y
CONFIG_BOOTSTD_FULL=y
CONFIG_BOOTSTD_BOOTCOMMAND=y

# Boot args / console
CONFIG_EXTRA_ENV_SETTINGS="soc=rk3528\0kernel_addr_r=0x03000000\0fdt_addr_r=0x07f00000\0ramdisk_addr_r=0x0a200000\0"
CONFIG_REQUIRE_SERIAL_CONSOLE=y
CONFIG_BOOTDELAY=0
CONFIG_AUTOBOOT_KEYED=y
CONFIG_AUTOBOOT_STOP_STR="stop"
CONFIG_SYS_CONSOLE_INFO_QUIET=y

# Misc
CONFIG_BOARD_RNG_SEED=y
CONFIG_ERRNO_STR=y
# CONFIG_DISPLAY_CPUINFO is not set
```

## files/package/boot/uboot-rockchip/configs/hinlink_h29k_defconfig
```kconfig
# Hinlink H29K (RK3528) U-Boot configuration for OpenWrt main branch
# Pure Mainline Compliant — Aligned with OpenWrt v25.12.0+

CONFIG_ARM=y
CONFIG_ARM64=y
CONFIG_ARCH_ROCKCHIP=y
CONFIG_SYS_SOC="rockchip"
CONFIG_TEXT_BASE=0x00200000
CONFIG_SYS_MALLOC_LEN=0x2000000
CONFIG_SYS_MALLOC_F_LEN=0x4000
CONFIG_NR_DRAM_BANKS=2
CONFIG_HAS_CUSTOM_SYS_INIT_SP_ADDR=y
CONFIG_CUSTOM_SYS_INIT_SP_ADDR=0x00c00000

# === 基础架构与组件 ===
CONFIG_FIT=y
CONFIG_SPL=y
CONFIG_TPL=y
CONFIG_SPL_LIBCOMMON_SUPPORT=y
CONFIG_SPL_LIBGENERIC_SUPPORT=y
CONFIG_SPL_SERIAL_SUPPORT=y
CONFIG_SPL_GPIO_SUPPORT=y
CONFIG_SPL_MMC_SUPPORT=y
CONFIG_SPL_SEPARATE_BSS=y

# === 设备树控制 (修复灯下黑) ===
CONFIG_OF_CONTROL=y
CONFIG_SPL_OF_CONTROL=y
CONFIG_SPL_OF_PLATDATA=y

# === 现代 Binman 与 ATF ===
CONFIG_BINMAN=y
CONFIG_SPL_LOAD_FIT=y
CONFIG_SPL_ATF=y

# === 目标芯片定义 ===
CONFIG_ROCKCHIP_RK3528=y

# === 存储器与标准主线驱动 (DM) ===
CONFIG_DM=y
CONFIG_DM_GPIO=y
CONFIG_DM_MMC=y
CONFIG_MMC=y
CONFIG_MMC_SDHCI=y
CONFIG_MMC_SDHCI_ROCKCHIP=y
CONFIG_MMC_DW=y
CONFIG_MMC_DW_ROCKCHIP=y

# === 环境变量配置 ===
CONFIG_DEFAULT_DEVICE_TREE="rk3528-hinlink-h29k"
CONFIG_ENV_IS_IN_MMC=y
CONFIG_ENV_OFFSET=0x3f8000
CONFIG_ENV_SIZE=0x8000
CONFIG_SYS_REDUNDAND_ENVIRONMENT=y
CONFIG_ENV_OFFSET_REDUND=0x3f0000

# === 常用主线命令集 ===
CONFIG_CMD_BOOTZ=y
CONFIG_CMD_BOOTI=y
CONFIG_CMD_MMC=y
CONFIG_CMD_GPT=y
CONFIG_CMD_PART=y
CONFIG_CMD_FS_GENERIC=y
CONFIG_CMD_FAT=y
CONFIG_CMD_EXT4=y
CONFIG_CMD_GPIO=y

# === 串口与控制台 ===
CONFIG_REQUIRE_SERIAL_CONSOLE=y
CONFIG_SYS_NS16550=y
CONFIG_BAUDRATE=1500000

# === 内存布局划分 ===
CONFIG_SPL_STACK=0x00400000
CONFIG_SPL_BSS_START_ADDR=0x00408000
CONFIG_SPL_BSS_MAX_SIZE=0x4000
CONFIG_TPL_STACK=0x00400000
CONFIG_TPL_BSS_START_ADDR=0x0040c000
CONFIG_TPL_BSS_MAX_SIZE=0x2000
```

## files/target/linux/rockchip/files/arch/arm64/configs/rockchip_defconfig
```kconfig
# RK3528-specific rockchip_defconfig for OpenWrt
# Path: target/linux/rockchip/files/arch/arm64/configs/rockchip_defconfig
# ✅ Loaded via 'CONFIG_EXTRA_KCONFIG_FILES' in target/linux/rockchip/Makefile
# ✅ Merged *after* generic/config-6.12 and rockchip/armv8/config-6.12
# ✅ Final symbol priority: files/ > armv8/ > generic/

#
# RK3528 SoC Core
#
CONFIG_ARCH_ROCKCHIP=y
CONFIG_ARCH_MULTI_V8=y
CONFIG_ARM64_ERRATUM_2441130=y
CONFIG_ROCKCHIP_RK3528_PMU=y
CONFIG_ROCKCHIP_SARADC=y
CONFIG_ROCKCHIP_I2C=y
CONFIG_ROCKCHIP_DRM_VOP2=y
CONFIG_ROCKCHIP_VOP2_KMS=y
CONFIG_ROCKCHIP_RGA=y
CONFIG_ROCKCHIP_USBPHY=y
CONFIG_ROCKCHIP_USB3PHY=y
CONFIG_ROCKCHIP_EMMC=y
CONFIG_ROCKCHIP_SDIO=y
CONFIG_ROCKCHIP_SPI=y
CONFIG_ROCKCHIP_GPIO=y
CONFIG_ROCKCHIP_PINCTRL=y
CONFIG_ROCKCHIP_CLK_RK3528=y
CONFIG_ROCKCHIP_PM_DOMAINS=y
CONFIG_ROCKCHIP_PM=y
CONFIG_ROCKCHIP_CPUFREQ=y
CONFIG_ROCKCHIP_THERMAL=y
CONFIG_ROCKCHIP_WATCHDOG=y
CONFIG_ROCKCHIP_WDT=y

#
# Storage & USB (H29K hardware)
#
CONFIG_MMC=y
CONFIG_MMC_BLOCK=y
CONFIG_MMC_ARMMMCI=y
CONFIG_MMC_SDHCI=y
CONFIG_MMC_SDHCI_PLTFM=y
CONFIG_MMC_SDHCI_OF_ROCKCHIP=y
CONFIG_USB=y
CONFIG_USB_COMMON=y
CONFIG_USB_ARCH_HAS_HCD=y
CONFIG_USB_DWC3=y
CONFIG_USB_DWC3_ROCKCHIP=y
CONFIG_USB_DWC3_GADGET=y

#
# Minimal required subsystems
#
CONFIG_NET=y
CONFIG_INET=y
CONFIG_PROC_FS=y
CONFIG_SYSFS=y
CONFIG_TMPFS=y
CONFIG_EXT4_FS=y
CONFIG_PRINTK=y
CONFIG_DEBUG_FS=y
CONFIG_MAGIC_SYSRQ=y

#
# Explicitly disable unsupported features (prevents auto-enable via generic config)
#
# Audio — H29K has no codec or I2S routing
CONFIG_SND_SOC_ROCKCHIP=n
CONFIG_SND_SOC_ROCKCHIP_I2S=n
CONFIG_SND_SOC_ROCKCHIP_SPDIF=n
CONFIG_SND_SOC_ROCKCHIP_HDMI=n

# PCIe — H29K has no PCIe slot or controller
CONFIG_PCIE_ROCKCHIP_HOST=n
CONFIG_PCIE_ROCKCHIP_EP=n

# HDMI CEC / IR — no hardware
CONFIG_RC_CORE=n
CONFIG_RC_DEVICES=n

# Bluetooth / WiFi modules — not on-board (USB-only)
CONFIG_BT=n
CONFIG_CFG80211=n
CONFIG_MAC80211=n

# GPU acceleration (Mali) — not used in OpenWrt headless context
CONFIG_DRM_ARMADA=n
CONFIG_DRM_ETNAVIV=n
CONFIG_DRM_PANFROST=n

# Legacy Rockchip drivers (RK3288/RK3399 only)
CONFIG_ROCKCHIP_IOMMU=n
CONFIG_ROCKCHIP_RK3399_DMC=n
CONFIG_ROCKCHIP_RK3328_DMC=n
```

## hinlink_h29k_defconfig
```kconfig
CONFIG_ARM64=y
CONFIG_TARGET_RK3528=y
CONFIG_SYS_BOARD="hinlink_h29k"
CONFIG_SYS_VENDOR="HINLINK"
CONFIG_SYS_SOC="rk3528"
CONFIG_SYS_CONFIG_NAME="hinlink_h29k"
CONFIG_DEFAULT_DEVICE_TREE="rk3528-hinlink-h29k"
CONFIG_ROCKCHIP_RK3528=y
CONFIG_SPL_GPIO_SUPPORT=y
CONFIG_SPL_SERIAL_SUPPORT=y
CONFIG_SPL_MMC_SUPPORT=y
CONFIG_SPL_FS_FAT=y
CONFIG_SPL_I2C_SUPPORT=y
CONFIG_SPL_SPI_FLASH_SUPPORT=y
CONFIG_SPL_SPI=y
CONFIG_SPL_USB_HOST_SUPPORT=y
CONFIG_SPL_USB_STORAGE=y
CONFIG_SPL_USB_GADGET=y
CONFIG_SPL_USB_DWC3=y
CONFIG_SPL_LIBCOMMON_SUPPORT=y
CONFIG_SPL_LIBGENERIC_SUPPORT=y
CONFIG_SPL_LIBDISK_SUPPORT=y
CONFIG_SPL_LIBMMC_SUPPORT=y
CONFIG_SPL_LIBPAYLOAD_SUPPORT=y
CONFIG_SPL_CLK_RK3528=y
CONFIG_SPL_PINCTRL=y
CONFIG_SPL_DM=y
CONFIG_SPL_OF_CONTROL=y
CONFIG_SPL_OF_LIBFDT=y
CONFIG_SPL_LOAD_FIT=y
CONFIG_SPL_FIT_GENERATOR="arch/arm/mach-rockchip/mkimage_fit_atf.sh"
CONFIG_SPL_ATF=y
CONFIG_SPL_ATF_BL31="bl31-rk3528.bin"
CONFIG_SPL_STACK_R_ADDR=0x00100000
CONFIG_SPL_TEXT_BASE=0x00000000
CONFIG_SPL_MAX_SIZE=0x10000
CONFIG_SPL_BSS_START_ADDR=0x00080000
CONFIG_SPL_BSS_MAX_SIZE=0x8000
```

## package/boot/uboot-rockchip/configs/Kconfig
```kconfig
if TARGET_HINLINK_H29K

config SYS_BOARD
	default "h29k"

config SYS_VENDOR
	default "hinlink"

endif
```

## package/boot/uboot-rockchip/configs/hinlink/Kconfig
```kconfig
# SPDX-License-Identifier: GPL-2.0+
config VENDOR_HINLINK
	bool
	help
	  Selected when any Hinlink board is enabled.

if VENDOR_HINLINK

source "board/hinlink/h29k/Kconfig"

endif
```

## package/boot/uboot-rockchip/configs/hinlink/h29k/Kconfig
```kconfig
# SPDX-License-Identifier: GPL-2.0+
config TARGET_HINLINK_H29K
	bool "Hinlink H29K RK3528 Board"
	select VENDOR_HINLINK
	select ARCH_ROCKCHIP

if TARGET_HINLINK_H29K

config SYS_VENDOR
	default "hinlink"

config SYS_BOARD
	default "h29k"

config SYS_SOC
	default "rk3528"

config SYS_CONFIG_NAME
	default "hinlink-h29k-rk3528"

endif
```
